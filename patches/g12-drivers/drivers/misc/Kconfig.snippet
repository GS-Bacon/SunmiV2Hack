## patches/g12-drivers/drivers/misc/Kconfig.snippet
```kconfig
# Append to drivers/misc/Kconfig (or dedicated drivers/misc/sunmi/Kconfig if
# preferred). Wire from parent Kconfig with:  source "drivers/misc/Kconfig"

config SPI_PRINTER
	tristate "Sunmi V2 thermal printer SPI driver"
	depends on SPI && OF
	help
	  Support for the internal thermal printer on Sunmi V2 T5930 POS
	  terminals. Exposes /dev/spidev0.0 with spidev-compatible ioctls
	  and /sys/sunmi/ctrl/mcu_version for MCU firmware queries.

	  Must be paired with ODM_PRINTER_GPIO for GPIO/IRQ control.

config ODM_PRINTER_GPIO
	tristate "Sunmi V2 printer GPIO/IRQ driver"
	depends on GPIOLIB && OF
	help
	  GPIO + IRQ + sysfs driver for the Sunmi V2 thermal printer
	  power/reset/level/handshake lines. Creates
	  /sys/printer_pin/printer/ with 11 attributes.

	  Companion to SPI_PRINTER.
```

## patches/g12-drivers/drivers/power/oz8806/Kconfig
```kconfig
# SPDX-License-Identifier: GPL-2.0

config BATTERY_OZ8806
	tristate "O2Micro OZ8806 fuel gauge (BMT reference, Sunmi V2 shims)"
	depends on I2C
	select POWER_SUPPLY
	help
	  Support for the O2Micro OZ8806 battery management IC used on the
	  Sunmi V2 T5930 POS terminal. This driver is based on the BMT
	  reference design shipped in the MT6755 BSP with Sunmi-side shims
	  to preserve OEM symbol names (typo alias, boot_up_time synonym) and
	  the CV set-point module parameter (sunmi_constant_voltage=8438000).
```
